## Kconfig
```kconfig
menu "nico's Extra Drivers"
comment "Extra Module"

rsource "drivers/Kconfig"
rsource "utils/Kconfig"

config APPLICATION_DEFINED_SYSCALL
    default y

endmenu
```

## Kconfig.nico
```kconfig
menu "nico's Extra Drivers"
comment "Extra Module"

rsource "drivers/Kconfig"

config APPLICATION_DEFINED_SYSCALL
    default y

endmenu
```

## drivers/Kconfig
```kconfig
comment "Extra Drivers"
rsource "nfc/Kconfig"
rsource "sensor/Kconfig"
rsource "dac/Kconfig"
```

## drivers/dac/mcp4716/Kconfig
```kconfig
# DAC configuration options

# Copyright (c) 2021 Laird Connectivity
#
# SPDX-License-Identifier: Apache-2.0

config MCP4716
	bool "Microchip MCP4716 DAC driver"
	default y
	select I2C
	depends on DT_HAS_MICROCHIP_MCP4716_ENABLED
	help
	  Enable the driver for the Microchip MCP4716.

if MCP4716

choice
	prompt "MCP4716 I2C bus speed"
	default MCP4716_I2C_SPEED_FAST

config MCP4716_I2C_SPEED_STANDARD
	bool "Standard"
	help
	  Standard bus speed of up to 100kHz.

config MCP4716_I2C_SPEED_FAST
	bool "Fast"
	help
	  Fast bus speed of up to 400KHz.

config MCP4716_I2C_SPEED_HIGH_SPEED
	bool "High Speed"
	help
	  Fast bus speed of up to 3.4MHz.

endchoice



choice
	prompt "MCP4716 Resolution"
	default MCP4716_RESOLUTION_10

config MCP4716_RESOLUTION_8
	bool "8 bits"
	help
	  8 bit resolution

config MCP4716_RESOLUTION_10
	bool "10 bits"
	help
	  10 bit resolution

config MCP4716_RESOLUTION_12
	bool "12 bits"
	help
	  12 bit resolution

endchoice


config DAC_MCP4716_INIT_PRIORITY
	int "Init priority"
	default 80
	help
	  Microchip MCP4716 DAC device driver initialization priority.

endif # DAC_MCP4716
```

## drivers/nfc/Kconfig
```kconfig
# NFC configuration options

menuconfig NFC
	bool "NFC Drivers"
	help
	  Include NFC drivers in system config

if NFC

module = NFC
module-str = nfc

source "subsys/logging/Kconfig.template.log_config"

config NFC_INIT_PRIORITY
	int "NFC init priority"
	default 90
	help
	  NFC initialization priority.

comment "Device Drivers"

rsource "st95hf/Kconfig"

endif # NFC
```

## drivers/nfc/st95hf/Kconfig
```kconfig
# ST95HF Three Axis Accelerometer configuration options

# Copyright (c) 2017 Intel Corporation
# SPDX-License-Identifier: Apache-2.0

menuconfig ST95HF
	bool "ST95HF Three Axis Accelerometer"
	default y
	depends on DT_HAS_ST_ST95HF_ENABLED
	select SPI if $(dt_compat_on_bus,$(DT_COMPAT_ST_ST95HF),spi)
	help
	  Enable SPI-based driver for ST95HF NFC.

if ST95HF

choice ST95HF_TRIGGER_MODE
	prompt "Trigger mode"
	help
	  Specify the type of triggering to be used by the driver.

config ST95HF_TRIGGER_NONE
	bool "No trigger"

config ST95HF_TRIGGER_GLOBAL_THREAD
	bool "Use global thread"
	depends on GPIO
	select ST95HF_TRIGGER

config ST95HF_TRIGGER_OWN_THREAD
	bool "Use own thread"
	depends on GPIO
	select ST95HF_TRIGGER

endchoice

config ST95HF_TRIGGER
	bool

config ST95HF_THREAD_PRIORITY
	int "Thread priority"
	depends on ST95HF_TRIGGER_OWN_THREAD
	default 10
	help
	  Priority of thread used by the driver to handle interrupts.

config ST95HF_THREAD_STACK_SIZE
	int "Thread stack size"
	depends on ST95HF_TRIGGER_OWN_THREAD
	default 1024
	help
	  Stack size of thread used by the driver to handle interrupts.

config ST95HF_BLOCK_DATA_UPDATE
	bool "Output registers not updated until MSB and LSB read"

config ST95HF_VERBOSE
	bool	"Enable Verbose logging"
	default n

choice ST95HF_READ_MODE
	prompt "Read mode"
	default ST95HF_READ_AS_DATASHEET
	help
	  Specify the type of reading to be used by the driver, if follows the Datasheet or follows the Demo code

config ST95HF_READ_AS_DATASHEET
	bool "Read structure as Datasheet"

config ST95HF_READ_AS_DEMO
	bool "Read structure as demo"
	
endchoice
endif # ST95HF
```

## drivers/sensor/bma456/Kconfig
```kconfig
# BMA456 Three Axis Accelerometer configuration options

# Copyright (c) 2017 Intel Corporation
# SPDX-License-Identifier: Apache-2.0

menuconfig BMA456
	bool "BMA456 Three Axis Accelerometer"
	default y
	depends on DT_HAS_BOSCH_BMA456_ENABLED
	select I2C if $(dt_compat_on_bus,$(DT_COMPAT_BOSCH_BMA456),i2c)
	select SPI if $(dt_compat_on_bus,$(DT_COMPAT_BOSCH_BMA456),spi)
	help
	  Enable SPI/I2C-based driver for BMA456, triaxial accelerometer sensors.

if BMA456

choice BMA456_TRIGGER_MODE
	prompt "Trigger mode"
	help
	  Specify the type of triggering to be used by the driver.

config BMA456_TRIGGER_NONE
	bool "No trigger"

config BMA456_TRIGGER_GLOBAL_THREAD
	bool "Use global thread"
	depends on GPIO
	select BMA456_TRIGGER

config BMA456_TRIGGER_OWN_THREAD
	bool "Use own thread"
	depends on GPIO
	select BMA456_TRIGGER

endchoice

config BMA456_TRIGGER
	bool

config BMA456_THREAD_PRIORITY
	int "Thread priority"
	depends on BMA456_TRIGGER_OWN_THREAD
	default 10
	help
	  Priority of thread used by the driver to handle interrupts.

config BMA456_THREAD_STACK_SIZE
	int "Thread stack size"
	depends on BMA456_TRIGGER_OWN_THREAD
	default 1024
	help
	  Stack size of thread used by the driver to handle interrupts.

choice BMA456_ACCEL_RANGE
	prompt "Acceleration measurement range"
	default BMA456_ACCEL_RANGE_RUNTIME
	help
	  Initial measurement full scale range for acceleration values.

config BMA456_ACCEL_RANGE_RUNTIME
	bool "Set at runtime"

config BMA456_ACCEL_RANGE_2G
	bool "+/-2g"

config BMA456_ACCEL_RANGE_4G
	bool "+/-4g"

config BMA456_ACCEL_RANGE_8G
	bool "+/-8g"

config BMA456_ACCEL_RANGE_16G
	bool "+/-16g"

endchoice

choice BMA456_OPER_MODE
	prompt "Operation mode"
	default BMA456_OPER_MODE_LOW_POWER
	help
	  Choose between performance or low power operation
	  mode for chip at init.

config BMA456_OPER_MODE_PERFORMANCE
	bool "Performance mode accel"

config BMA456_OPER_MODE_LOW_POWER
	bool "Low power mode"

endchoice

choice BMA456_ODR
	prompt "Output data rate frequency"
	default BMA456_ODR_RUNTIME
	help
	  Initial data rate frequency of acceleration data at initialization.
	  Supported values:
	  12.5Hz, 25Hz, 50Hz, 100Hz, 200Hz, 400Hz, 800Hz, 1600Hz in all modes (performance and low power)
	  0.78Hz, 1.56Hz, 3.125Hz, 6.25Hz, in low power mode only

config BMA456_ODR_RUNTIME
	bool "Set at runtime"

config BMA456_ODR_0_78
	bool "0.78Hz"
	depends on BMA456_OPER_MODE_LOW_POWER	
	
config BMA456_ODR_1_56
	bool "1.56Hz"
	depends on BMA456_OPER_MODE_LOW_POWER	

config BMA456_ODR_3_125
	bool "3.125Hz"
	depends on BMA456_OPER_MODE_LOW_POWER	

config BMA456_ODR_6_25
	bool "6.25Hz"
	depends on BMA456_OPER_MODE_LOW_POWER	

config BMA456_ODR_12_5
	bool "12.5Hz"

config BMA456_ODR_25
	bool "25Hz"

config BMA456_ODR_50
	bool "50Hz"

config BMA456_ODR_100
	bool "100Hz"

config BMA456_ODR_200
	bool "200KHz"

config BMA456_ODR_400
	bool "400KHz"

config BMA456_ODR_800
	bool "800KHz"

config BMA456_ODR_1600
	bool "1600KHz"

endchoice

choice BMA456_VARIANT
prompt "BMA456 Variant"
	default BMA456_VARIANT_MM
	help
	  BMA456, the same chip, has three variants. By default, BMA456 is for wearable applications such as smart watch,
	  wristband, etc. If BMA456 is downloaded with another config file, then it becomes BMA456H which is for hearable
	  applications such as headphone, earbud, etc. BMA456H has the triple-tap interrupt feature added.
	  BMA456MM is a variant of BMA456 with specialized config file that supports most interrupt features of BMA253 and
	  BMA280 for mass market.


config BMA456_VARIANT_MM
	bool "BMA456MM (mass market)"

config BMA456_VARIANT_H
	bool "BMA456H (hearable applications)"

config BMA456_VARIANT_W
	bool "BMA456W (wearable applications)"

config BMA456_VARIANT_AN
	bool "BMA456AN (just any motion and no motion)"

endchoice

config BMA456_MEASURE_TEMPERATURE
	bool "Temperature measurements"
	help
	  The temperature sensor has 8 bits. The temperature value is updated every 1.28 s.
	  The temperature sensor is always on, when the accelerometer sensor is active.

endif # BMA456
```

## dts/bindings/nfc/st,st95hf.yaml
```yaml
# Copyright (c) 2018 STMicroelectronics
# SPDX-License-Identifier: Apache-2.0

description: STMicroelectronics ST95HF Near field communication transceiver

compatible: "st,st95hf"

include: "spi-device.yaml"

properties:
    irq-in-gpios:
      type: phandle-array
      required: true
      description: Interrupt input

        Input interrupt to wake up the sensor.
        Internally connected to a Very Weak Pull-up to VPS

    irq-out-gpios:
      type: phandle-array
      required: false
      description: Interrupt output

        Interrupt an external device or microprocessor.
        When not used, it can be left unconnected. 
        Internally connected to a Weak Pull-up to VPS.

    ssi-gpios:
      type: phandle-array
      required: false
      description: Interrupt output

        Interrupt an external device or microprocessor.
        When not used, it can be left unconnected. 
        Internally connected to a Weak Pull-up to VPS.
```

## dts/bindings/sensor/bosch,bma456.yaml
```yaml
# Copyright (c) 2020 Nordic Semiconductor ASA
# SPDX-License-Identifier: Apache-2.0

description: |
  Bosch BMA456 triaxial acceleration sensor.  See more info at:
  https://www.bosch-sensortec.com/products/motion-sensors/accelerometers/bma456.html

compatible: "bosch,bma456"

include: [sensor-device.yaml, i2c-device.yaml]

properties:
  int1-gpios:
    type: phandle-array
    required: false
    description: |
      Identifies pins for the INT1 on the sensor. 
  int2-gpios:
    type: phandle-array
    required: false
    description: |
      Identifies pins for the INT2 on the sensor. 
                
  int-non-latched:
    type: boolean
    required: false
    description: |
      Specifies if the interrupts are non-latched. Default = latched

  anym-on-int1:
    type: boolean
    required: false
    description: |
      Indicates that the device driver should use interrupt 1
      for any movement. This is for boards that only have one
      interrupt line connected from the sensor to the processor.
      It disables the DataRDY interrupt

  anym-mode:
    type: int
    required: false
    default: 0
    description: |
      Select the interrupt mode for any movement.

      0 = OR combination of interrupt events
      1 = 6D movement recognition
      2 = AND combination of interrupt events
      3 = 6D position recognition

      The default of 0 is the power-on-reset value.
    enum:
      - 0
      - 1
      - 2
      - 3


  is-bmc150:
    type: boolean
    required: false
    description: |
      Specifies that the driver should adapt to the accelerometer
      capability provided by the BMC150 6-axis eCompass.  This affects
      the chip ID and the resolution of the measurements.
```

## utils/Kconfig
```kconfig
comment "Extra Utils"


menuconfig EXTRA_UTILS
	bool "Extra utils"
	default y
	help
	  Enable compilation of some helpful utils.

if EXTRA_UTILS

config EXTRA_UTILS_BASIC
	bool "Basic Extra Utils"
    default y
	help
	  Enable compilation of buffer_append, buffer_extract and crc helper functions

config EXTRA_UTILS_VOLT_DIVIDER
	bool "Voltage Divider driver"
    default y
    depends on ADC_NRFX_SAADC
	help
	  Enable compilation of buffer_append, buffer_extract and crc helper functions

config EXTRA_UTILS_WORK_QUERY
	bool "Work Query helper"
    default y
	help
	  Enable compilation of work query helper

config EXTRA_UTILS_APP_PIN
	bool "App pin helper"
    default y
	help
	  Enable compilation of app pin helpers

config EXTRA_UTILS_APP_ALARM
	bool "App alarm helper"
    default y
	help
	  Enable compilation of app alarm helpers

config EXTRA_UTILS_WAV
	bool "WAV file helpers"
    default y
    depends on I2S
	help
	  Enable compilation of wav files helpers

config EXTRA_UTILS_MP3
	bool "MP3 file helpers"
    default y
    depends on I2S
	help
	  Enable compilation of mp3 files helpers



config EXTRA_UTILS_PACKET
	bool "Packet helpers"
    default y
    depends on SERIAL
	help
	  Enable compilation of packet helpers


config PACKET_RX_TIMEOUT
	int "Timeout for packet reception"
	default 10
	depends on EXTRA_UTILS_PACKET


config PACKET_MAX_PL_LEN
	int "Timeout for packet reception"
	default 256
	depends on EXTRA_UTILS_PACKET

config PACKET_THREAD_PRIORITY
	int "Priority for the packet thread"
	default 3
	depends on EXTRA_UTILS_PACKET


endif # BMA456
```

## west.yml
```yaml
manifest:
  remotes:
    - name: nico-repo
      url-base: https://github.com/nvelozsavino      
  projects:
    - name: tiny-json
      remote: nico-repo
      path: modules/lib/tiny-json
      revision: develop
```
